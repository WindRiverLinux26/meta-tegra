## conf/layer.conf
```bitbake
BBPATH .= ":${LAYERDIR}"

BSP_NVIDIA_DERIVED ??= ""
BBFILES += "${@bb.utils.contains_any('MACHINE', '${BSP_NVIDIA_DERIVED}', '${LAYERDIR}/recipes-*/*/*.bb', '', d)}"
BBFILES += "${@bb.utils.contains_any('MACHINE', '${BSP_NVIDIA_DERIVED}', '${LAYERDIR}/recipes-*/*/*.bbappend', '', d)}"

BBFILE_COLLECTIONS += "tegra"
BBFILE_PATTERN_tegra = "^${LAYERDIR}/"
BBFILE_PRIORITY_tegra = "5"

LAYERVERSION_tegra = "1"

LAYERDEPENDS_tegra = "core"

LAYERSERIES_COMPAT_tegra = "whinlatter wrynose"

# Recipe modifications for other layers that may be included in the build
EXTRA_BBFILES += "${@' '.join('${LAYERDIR}/external/%s/recipes*/*/*.bb' % layer \
               for layer in BBFILE_COLLECTIONS.split() if os.path.exists(os.path.join('${LAYERDIR}','external',layer)))}"
EXTRA_BBFILES += "${@' '.join('${LAYERDIR}/external/%s/recipes*/*/*.bbappend' % layer \
               for layer in BBFILE_COLLECTIONS.split() if os.path.exists(os.path.join('${LAYERDIR}','external',layer)))}"

BBFILES += "${@bb.utils.contains_any('MACHINE', '${BSP_NVIDIA_DERIVED}', '${EXTRA_BBFILES}', '', d)}"

RECIPE_LIST_REASON:tegra = "You are about to enable third-party components, there is additional third-part licensing involved, and you might need to consult with your legal department."

SIGGEN_EXCLUDE_SAFE_RECIPE_DEPS += "\
  gcc-for-nvcc-cross-${TARGET_ARCH}->linux-libc-headers \
"

addpylib ${LAYERDIR}/lib oe4t

BBMASK += "${LAYERDIR}/recipes-kernel/linux/linux-yocto_6.18.bbappend"
```
